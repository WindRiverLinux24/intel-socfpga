## conf/layer.conf
```bitbake
#
# Copyright (C) 2017, 2019 Wind River Systems, Inc.
#

# We have a conf and classes directory, add to BBPATH
BBPATH =. "${LAYERDIR}:"

# We have a packages directory, add to BBFILES
BBFILES += "${LAYERDIR}/recipes-*/*/*.bb \
 	${LAYERDIR}/recipes-*/*/*.bbappend"

BBFILE_COLLECTIONS += "intel-socfpga"
BBFILE_PATTERN_intel-socfpga = "^${LAYERDIR}/"
BBFILE_PRIORITY_intel-socfpga = "7"

# This should only be incremented on significant changes that will
# cause compatibility issues with other layers
LAYERVERSION_intel-socfpga = "1"

LAYERDEPENDS_intel-socfpga = "core wrlinux"
LAYERRECOMMENDS_intel-socfpga = "intel-socfpga-dl"
LAYERSERIES_COMPAT_intel-socfpga = "dunfell gatesgarth"
```

## conf/machine/include/fcs.inc
```bitbake
FCS_KEY_DIR ?= "${TMPDIR}/fcs_keydir"
ROOT_KEY ?= "${FCS_KEY_DIR}/root0.qky"
HPS_PRIVATE_KEY ?= "${FCS_KEY_DIR}/software0.pem"
HPS_SIGNATURE_CHAIN ?= "${FCS_KEY_DIR}/software0_cancel3.qky"
FPGA_PRIVATE_KEY ?= "${FCS_KEY_DIR}/sign0.pem"
FPGA_SIGNATURE_CHAIN ?= "${FCS_KEY_DIR}/sign0_cancel1.qky"
```

## conf/machine/intel-socfpga-64.conf
```bitbake
#
# Copyright (C) 2021 Wind River Systems, Inc.
#
#@TYPE: Machine
#@NAME: socfpga
#@DESCRIPTION: Machine configuration for Intel Stratix 10 SoC

DEFAULTTUNE = "cortexa53"
require conf/machine/include/arm/armv8a/tune-cortexa53.inc

MACHINE_FEATURES += "pci usbhost ext3 jffs2 alsa profile"

KERNEL_IMAGETYPE = ""
KERNEL_IMAGETYPES = "Image.gz Image"
KERNEL_DEVICETREE = "altera/socfpga_stratix10_socdk.dtb \
		     altera/socfpga_stratix10_fpga_update.dtb \
		     altera/socfpga_stratix10_socdk_pcie.dtb \
		     altera/socfpga_stratix10_socdk_sgmii.dtb \
		     altera/socfpga_stratix10_socdk_ghrd.dtb \
		     altera/socfpga_stratix10_socdk_nand.dtb \
		     intel/socfpga_agilex_socdk.dtb \
		     intel/socfpga_agilex_socdk_nand.dtb \
		     intel/socfpga_agilex_socdk_ghrd.dtb \
		     intel/socfpga_agilex_socdk_sgmii.dtb \
		     intel/socfpga_agilex_socdk_nand_ghrd.dtb \
		     intel/socfpga_agilex_socdk_nand_sgmii.dtb \
		     intel/socfpga_agilex_fpga_update.dtb"

SERIAL_CONSOLE = "115200 ttyS0"

# multilib support
MULTILIBS ?= "multilib:lib32"
DEFAULTTUNE:virtclass-multilib-lib32 ?= "armv7athf-neon"

EXTRA_IMAGECMD:jffs2 ?= "--pad --no-cleanmarkers --eraseblock=0x10000"

MACHINE_EXTRA_RRECOMMENDS = " kernel-modules kernel-devicetree"
IMAGE_FSTYPES += "tar.bz2 wic wic.bmap"
WKS_FILE ?= "stratix10-sdimage.wks"
IMAGE_INSTALL:append = " kernel-devicetree kernel-image-image"
do_image_wic[depends] += "mtools-native:do_populate_sysroot dosfstools-native:do_populate_sysroot"
do_image_wic[depends] += "u-boot-socfpga:do_deploy"

IMAGE_BOOT_FILES ?= "u-boot-dtb.img u-boot.img Image socfpga_stratix10_socdk.dtb socfpga_stratix10_socdk_pcie.dtb \
			socfpga_stratix10_socdk_sgmii.dtb socfpga_stratix10_socdk_ghrd.dtb socfpga_stratix10_socdk_nand.dtb boot.scr ghrd.core.rbf u-boot.itb \
			socfpga_agilex_socdk.dtb socfpga_agilex_socdk_nand.dtb socfpga_agilex_socdk_ghrd.dtb socfpga_agilex_socdk_sgmii.dtb \
			socfpga_agilex_socdk_nand_ghrd.dtb socfpga_agilex_socdk_nand_sgmii.dtb"

PREFERRED_PROVIDER_virtual/bootloader ?= "u-boot-socfpga"
BB_MULTI_PROVIDER_ALLOWED += "virtual/bootloader"

UBOOT_CONFIG ?=  "stratix10-socdk-mmc agilex-socdk-mmc agilex-socdk-nand"

PREFERRED_VERSION_linux-yocto ?= "5.15%"

UBOOT_SUFFIX = "img"

NON_MULTILIB_RECIPES:append = " u-boot-socfpga"
NON_MULTILIB_RECIPES:append = " u-boot-fw-utils"
NON_MULTILIB_RECIPES:append = " s10-u-boot-scr"
NON_MULTILIB_RECIPES:append = " arm-trusted-firmware"

# For ostree
# No u-boot
OSTREE_SD_UBOOT_WIC1 ?= ""

INITRAMFS_IMAGE ??= ""
IMAGE_BOOT_FILES:append = " ${@bb.utils.contains('DISTRO_FEATURES', 'ostree', '${INITRAMFS_IMAGE}-${MACHINE}.${INITRAMFS_FSTYPES};initramfs boot.scr', '', d)}"
OSTREE_KERNEL ?= "Image"
DEFAULT_DTB ?= "socfpga_stratix10_socdk.dtb"
OSTREE_COPY_IMAGE_BOOT_FILES = "1"
OSTREE_UBOOT_CMD ?= "run linux_qspi_enable; booti"

# For ustart.img
OSTREE_NETINST_DEV ?= "/dev/mmcblk0,/dev/sda,/dev/vda"
OSTREE_NETINST_ARGS ?= "${OSTREE_CONSOLE} bl=ufsd rdinit=/install instdev=${OSTREE_NETINST_DEV} instname=wrlinux instbr=\$BRANCH insturl=\$URL instab=${OSTREE_USE_AB} instsf=1 instdate=BUILD_DATE"
OSTREE_CONSOLE_AUX:intel-socfpga-64 ?= "console=ttyS0,115200 "
```

## recipes-bsp/s10-u-boot-scr/files/boot.its
```
// SPDX-License-Identifier: GPL-2.0
/*
 * Copyright (C) 2019 Intel Corporation
 *
 */

/dts-v1/;

/ {
	description = "U-Boot script";

	images {
		script {
			description = "FIT format of U-Boot script";
			type = "script";
			arch = "arm64";
			compression = "none";
			data = /incbin/("boot.txt");

			hash {
				algo = "crc32";
			};
		};
	};
};
```
